## firmware/main/Kconfig.projbuild
```kconfig
menu "Smart Motor Monitor (Agro) - App Configuration"

    config APP_WIFI_SSID
        string "WiFi SSID"
        default ""
        help
            SSID de la red Wi-Fi.

    config APP_WIFI_PASS
        string "WiFi Password"
        default ""
        help
            Password de la red Wi-Fi.

    config APP_MQTT_BROKER_URI
        string "MQTT Broker URI"
        default "mqtt://192.168.1.11"
        help
            URI del broker MQTT. Ej: mqtt://192.168.1.11

    config APP_MQTT_CLIENT_ID
        string "MQTT Client ID"
        default "esp32c3-agro-001"
        help
            Client ID del dispositivo (debe ser único en el broker).

        config APP_MQTT_TOPIC_BASE
        string "MQTT Base Topic"
        default "agro/smart-motor"
        help
            Raíz de topics. El firmware publicará en:
            <base>/<device_id>/telemetry



endmenu
```
